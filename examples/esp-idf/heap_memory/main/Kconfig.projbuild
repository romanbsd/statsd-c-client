## examples/esp-idf/heap_memory/main/Kconfig.projbuild
```kconfig
menu "Project configuration"
    config PROJECT_DEST_ADDR
        string "IP address of the destination"
        default "192.168.1.100"
        help
            The IP address to send metrics to.
    config PROJECT_DEST_PORT
        int "The port number to send metrics to"
        default 8125
    config PROJECT_WIFI_SSID
        string "WiFi SSID"
        default "myssid"
        help
            WiFi SSID to connnect
    config PROJECT_WIFI_PASSWORD
        string "WiFi password"
        default "mypassword"
        help
            WiFi password
endmenu
```
